/* Copyright (c) 2013, The Linux Foundation. All rights reserved.
 *
 * This program is free software; you can redistribute it and/or modify
 * it under the terms of the GNU General Public License version 2 and
 * only version 2 as published by the Free Software Foundation.
 *
 * This program is distributed in the hope that it will be useful,
 * but WITHOUT ANY WARRANTY; without even the implied warranty of
 * MERCHANTABILITY or FITNESS FOR A PARTICULAR PURPOSE.  See the
 * GNU General Public License for more details.
 */

/*---------------------------------------------------------------------------
 * This file is autogenerated file using gcdb parser. Please do not edit it.
 * Update input XML file to add a new entry or update variable in this file
 * VERSION = "1.0"
 *---------------------------------------------------------------------------*/
&mdss_mdp {
      dsi_otm1283a_720p_video: qcom,mdss_dsi_otm1283a_720p_video {
				qcom,mdss-dsi-panel-name = "otm1283a 720p video mode dsi panel";
				qcom,mdss-dsi-panel-controller = <0x3e>;
				qcom,mdss-dsi-panel-type = "dsi_video_mode";
				qcom,mdss-dsi-panel-destination = "display_1";
				qcom,mdss-dsi-panel-framerate = <0x3c>;
				qcom,mdss-dsi-virtual-channel-id = <0x0>;
				qcom,mdss-dsi-stream = <0x0>;
				qcom,mdss-dsi-panel-width = <0x2d0>;
				qcom,mdss-dsi-panel-height = <0x500>;
				qcom,mdss-dsi-h-front-porch = <0x34>;
				qcom,mdss-dsi-h-back-porch = <0x64>;
				qcom,mdss-dsi-h-pulse-width = <0x18>;
				qcom,mdss-dsi-h-sync-skew = <0x0>;
				qcom,mdss-dsi-v-back-porch = <0x14>;
				qcom,mdss-dsi-v-front-porch = <0x8>;
				qcom,mdss-dsi-v-pulse-width = <0x4>;
				qcom,mdss-dsi-h-left-border = <0x0>;
				qcom,mdss-dsi-h-right-border = <0x0>;
				qcom,mdss-dsi-v-top-border = <0x0>;
				qcom,mdss-dsi-v-bottom-border = <0x0>;
				qcom,mdss-dsi-bpp = <0x18>;
				qcom,mdss-dsi-color-order = "rgb_swap_rgb";
				qcom,mdss-dsi-underflow-color = <0xff>;
				qcom,mdss-dsi-border-color = <0x0>;
				qcom,mdss-dsi-on-command = <0x29010000 0x200 0x290100 0x4 0xff128301 0x29010000 0x200 0x80290100 0x3 0xff128329 0x1000000 0x20092 0x29010000 0x2ff 0x30290100 0x2 0x932901 0x0 0x2ff0229 0x1000000 0x20080 0x29010000 0xac0 0x640010 0x10006410 0x10290100 0x2 0x902901 0x0 0x7c0005c 0x10004 0x29010000 0x200 0xb3290100 0x3 0xc0005029 0x1000000 0x20081 0x29010000 0x2c1 0x55290100 0x2 0x902901 0x0 0x2c44929 0x1000000 0x200e0 0x29010000 0x2c0 0xc8290100 0x2 0xa02901 0x0 0xfc40510 0x4020515 0x11051007 0x2051511 0x29010000 0x200 0xb0290100 0x3 0xc4000029 0x1000000 0x20091 0x29010000 0x3c5 0xa6d02901 0x0 0x2000029 0x1000000 0x3d8c7 0xc7290100 0x2 0x2901 0x0 0x2d98729 0x1000000 0x200b0 0x29010000 0x3c5 0x4382901 0x0 0x200bb29 0x1000000 0x2c580 0x29010000 0x200 0x82290100 0x2 0xc4022901 0x0 0x200c629 0x1000000 0x2b003 0x29010000 0x200 0x290100 0x2 0xd0402901 0x0 0x2000029 0x1000000 0x3d100 0x290100 0x2 0xb22901 0x0 0x3f50000 0x29010000 0x200 0xb4290100 0x3 0xf5000029 0x1000000 0x200b6 0x29010000 0x3f5 0x2901 0x0 0x200b829 0x1000000 0x3f500 0x290100 0x2 0x942901 0x0 0x2f50229 0x1000000 0x200ba 0x29010000 0x2f5 0x3290100 0x2 0xb42901 0x0 0x2c5c029 0x1000000 0x20090 0x29010000 0x5f5 0x2110211 0x29010000 0x200 0x90290100 0x2 0xc5502901 0x0 0x2009429 0x1000000 0x2c566 0x29010000 0x200 0x80290100 0xc 0xcb000000 0x0 0x0 0x29010000 0x200 0x90290100 0x10 0xcb000000 0x0 0x0 0x0 0x29010000 0x200 0xa0290100 0x10 0xcb000000 0x0 0x0 0x0 0x29010000 0x200 0xb0290100 0x10 0xcb000000 0x0 0x0 0x0 0x29010000 0x200 0xc0290100 0x10 0xcb050505 0x5050505 0x5050005 0x0 0x29010000 0x200 0xd0290100 0x10 0xcb000000 0x50000 0x5050505 0x5050505 0x29010000 0x200 0xe0290100 0xf 0xcb050005 0x0 0x0 0x5000029 0x1000000 0x200f0 0x29010000 0xccb 0xffffffff 0xffffffff 0xffffff29 0x1000000 0x20080 0x29010000 0x10cc 0x292a0a0c 0xe101214 0x6000800 0x29 0x1000000 0x20090 0x29010000 0x10cc 0x0 0x2000029 0x2a090b0d 0xf111329 0x1000000 0x200a0 0x29010000 0xfcc 0x5000700 0x0 0x1 0x2901 0x0 0x200b029 0x1000000 0x10cc29 0x2a13110f 0xd0b0901 0x70000 0x2901 0x0 0x200c029 0x1000000 0x10cc00 0x5 0x292a 0x1412100e 0xc0a2901 0x0 0x200d029 0x1000000 0xfcc02 0x80000 0x0 0x600 0x290100 0x2 0x802901 0x0 0xdce8905 0x10880510 0x0 0x2901 0x0 0x2009029 0x1000000 0xfce54 0xfc1054fd 0x10550010 0x55011000 0x290100 0x2 0xa02901 0x0 0xfce5807 0x4fc0010 0x580604 0xfd001000 0x29010000 0x200 0xb0290100 0xf 0xce580504 0xfe001000 0x580404ff 0x100029 0x1000000 0x200c0 0x29010000 0xfce 0x58030500 0x100058 0x2050100 0x10002901 0x0 0x200d029 0x1000000 0xfce58 0x1050200 0x10005800 0x5030010 0x290100 0x2 0x802901 0x0 0xfcf5000 0x5040010 0x500105 0x5001000 0x29010000 0x200 0x90290100 0xf 0xcf500205 0x6001000 0x50030507 0x100029 0x1000000 0x200a0 0x29010000 0xfcf 0x0 0x0 0x0 0x2901 0x0 0x200b029 0x1000000 0xfcf00 0x0 0x0 0x0 0x290100 0x2 0xc02901 0x0 0xccf3939 0x20200000 0x1012000 0x290100 0x2 0x2901 0x0 0x11e10212 0x180e070f 0xb090407 0xe080f12 0xc082901 0x0 0x2000029 0x1000000 0x11e202 0x12180e07 0x100b0a04 0x80e080f 0x120c0829 0x1000000 0x200b5 0x29010000 0x7c5 0xb95ff0b 0x95ff2901 0x0 0x2000029 0x1000000 0x4ffff 0xffff2901 0x7800 0x2110029 0x1000000 0x22900>;
				qcom,mdss-dsi-off-command = [05 01 00 00 00 00 02 28 00 05 01 00 00 78 00 02 10 00];
				qcom,mdss-dsi-on-command-state = "dsi_lp_mode";
				qcom,mdss-dsi-off-command-state = "dsi_hs_mode";
				qcom,mdss-dsi-h-sync-pulse = <0x1>;
				qcom,mdss-dsi-traffic-mode = "burst_mode";
				qcom,mdss-dsi-lane-map = "lane_map_0123";
				qcom,mdss-dsi-bllp-eof-power-mode;
				qcom,mdss-dsi-bllp-power-mode;
				qcom,mdss-dsi-lane-0-state;
				qcom,mdss-dsi-lane-1-state;
				qcom,mdss-dsi-lane-2-state;
				qcom,mdss-dsi-lane-3-state;
				qcom,mdss-dsi-panel-timings = <0x921a1200 0x3e42161e 0x14030400>;
				qcom,mdss-dsi-t-clk-post = <0x4>;
				qcom,mdss-dsi-t-clk-pre = <0x1c>;
				qcom,mdss-dsi-bl-min-level = <0x1>;
				qcom,mdss-dsi-bl-max-level = <0xff>;
				qcom,mdss-dsi-bl-pmic-pwm-frequency = <0x64>;
				qcom,mdss-dsi-bl-pmic-bank-select = <0x0>;
				qcom,mdss-dsi-dma-trigger = "trigger_sw";
				qcom,mdss-dsi-mdp-trigger = "none";
				qcom,mdss-dsi-bl-pmic-control-type = "bl_ctrl_pwm";
				qcom,mdss-dsi-reset-sequence = <0x1 0x1 0x0 0x32 0x1 0x32>;
				qcom,mdss-dsi-pwm-gpio = <0x3f 0x4 0x0>;
				qcom,cont-splash-enabled;
			};
		};
