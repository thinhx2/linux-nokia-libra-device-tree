/* Copyright (c) 2013, The Linux Foundation. All rights reserved.
 *
 * This program is free software; you can redistribute it and/or modify
 * it under the terms of the GNU General Public License version 2 and
 * only version 2 as published by the Free Software Foundation.
 *
 * This program is distributed in the hope that it will be useful,
 * but WITHOUT ANY WARRANTY; without even the implied warranty of
 * MERCHANTABILITY or FITNESS FOR A PARTICULAR PURPOSE.  See the
 * GNU General Public License for more details.
 */

qcom,nokia-BV5S-1800mAh {
			qcom,fcc-mah = <0x708>;
			qcom,default-rbatt-mohm = <0x71>;
			qcom,max-voltage-uv = <0x401640>;
			qcom,rbatt-capacitive-mohm = <0x32>;
			qcom,v-cutoff-uv = <0x33e140>;
			qcom,chg-term-ua = <0x249f0>;
			qcom,batt-id-kohm = <0x4e>;

			qcom,fcc-temp-lut {
				qcom,lut-col-legend = <0xffffffec 0x0 0x19 0x28 0x3c>;
				qcom,lut-data = <0x703 0x6fd 0x701 0x6fd 0x6e7>;
			};

			qcom,pc-temp-ocv-lut {
				qcom,lut-col-legend = <0xffffffec 0x0 0x19 0x28 0x3c>;
				qcom,lut-row-legend = <0x64 0x5f 0x5a 0x55 0x50 0x4b 0x46 0x41 0x3c 0x37 0x32 0x2d 0x28 0x23 0x1e 0x19 0x14 0x10 0xd 0xb 0xa 0x9 0x8 0x7 0x6 0x5 0x4 0x3 0x2 0x1 0x0>;
				qcom,lut-data = <0x10e2 0x10cc 0x10d1 0x10c3 0x10b9 0x106b 0x107b 0x1086 0x107f 0x1077 0x101e 0x103e 0x104a 0x1044 0x103d 0xfed 0x1006 0x1012 0x100e 0x1007 0xf99 0xfd4 0xfdf 0xfdc 0xfd5 0xf61 0xf93 0xfaf 0xfb0 0xfa7 0xf36 0xf68 0xf85 0xf83 0xf7e 0xf0e 0xf3f 0xf60 0xf5f 0xf59 0xef1 0xf1b 0xf3a 0xf3c 0xf36 0xee1 0xefe 0xf0d 0xf0e 0xf09 0xed3 0xee4 0xeef 0xeef 0xeec 0xec5 0xecf 0xeda 0xeda 0xed7 0xeb7 0xec1 0xeca 0xeca 0xec6 0xea6 0xeb7 0xebd 0xebe 0xeba 0xe94 0xeaa 0xeb6 0xeb0 0xea4 0xe80 0xe97 0xea9 0xea1 0xe8f 0xe67 0xe82 0xe95 0xe8d 0xe77 0xe4d 0xe72 0xe79 0xe71 0xe5c 0xe34 0xe65 0xe64 0xe5d 0xe4e 0xe20 0xe5c 0xe5d 0xe57 0xe4a 0xe14 0xe56 0xe5b 0xe56 0xe47 0xe05 0xe4e 0xe58 0xe53 0xe43 0xdf3 0xe42 0xe55 0xe4f 0xe39 0xddf 0xe2f 0xe4e 0xe47 0xe21 0xdc6 0xe13 0xe3d 0xe35 0xdfc 0xda4 0xdeb 0xe1b 0xe11 0xdce 0xd7a 0xdb7 0xde9 0xddf 0xd96 0xd3d 0xd72 0xda9 0xda0 0xd51 0xce5 0xd18 0xd53 0xd4b 0xcf9 0xc7a 0xca4 0xcd0 0xccc 0xc85 0xbb8 0xbb8 0xbb8 0xbb8 0xbb8>;
			};

			qcom,rbatt-sf-lut {
				qcom,lut-col-legend = <0xffffffec 0x0 0x19 0x28 0x3c>;
				qcom,lut-row-legend = <0x64 0x5f 0x5a 0x55 0x50 0x4b 0x46 0x41 0x3c 0x37 0x32 0x2d 0x28 0x23 0x1e 0x19 0x14 0x10 0xd 0xb 0xa 0x9 0x8 0x7 0x6 0x5 0x4 0x3 0x2 0x1>;
				qcom,lut-data = <0x515 0x141 0x64 0x51 0x4c 0x4fe 0x142 0x64 0x51 0x4c 0x4fe 0x142 0x64 0x51 0x4c 0x4ea 0x143 0x67 0x53 0x4d 0x490 0x153 0x6a 0x55 0x4f 0x466 0x142 0x70 0x58 0x50 0x454 0x13b 0x76 0x5b 0x53 0x44a 0x133 0x80 0x62 0x57 0x452 0x12c 0x86 0x6c 0x5d 0x471 0x129 0x6e 0x5b 0x53 0x4a6 0x127 0x65 0x54 0x4e 0x4f5 0x122 0x64 0x5d 0x4e 0x538 0x128 0x66 0x54 0x50 0x5a0 0x135 0x64 0x57 0x53 0x612 0x147 0x68 0x54 0x4e 0x6a0 0x162 0x6a 0x52 0x4d 0x752 0x19b 0x6c 0x55 0x4e 0x8b0 0x206 0x70 0x56 0x50 0xdb2 0x2a1 0x70 0x56 0x51 0x1393 0x343 0x74 0x58 0x53 0x15ae 0x37a 0x75 0x5a 0x55 0x1a0c 0x3be 0x79 0x5b 0x57 0x2042 0x45f 0x7f 0x5d 0x58 0x27d7 0x539 0x88 0x61 0x5d 0x3304 0x659 0x8e 0x65 0x65 0x40dd 0x83e 0x94 0x68 0x70 0x53f2 0xb0d 0x9f 0x70 0x7f 0x6ea6 0xeed 0xb4 0x7c 0x9b 0x967a 0x1548 0xdc 0x8f 0xd7 0x10bbc 0x3b1e 0x150 0xdc 0x650>;
			};
		};
